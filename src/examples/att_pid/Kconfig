## src/examples/att_pid/Kconfig
```kconfig
    menuconfig EXAMPLES_ATT_PID
	bool "att_pid"
	default n
	---help---
		Enable support for att_pid
```

## src/examples/my_hello/Kconfig
```kconfig
menuconfig EXAMPLES_MY_HELLO
	bool "my_hello"
	default n
	---help---
		Enable support for my_hello
```

## src/examples/my_work_queue/Kconfig
```kconfig
menuconfig EXAMPLES_MY_WORK_QUEUE
	bool "my_work_queue"
	default n
	---help---
		Enable support for my_work_queue
```
